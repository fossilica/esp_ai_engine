## sdkconfig.defaults
```kconfig
CONFIG_FREERTOS_HZ=1000
CONFIG_AUTOSTART_ARDUINO=y
CONFIG_ESP_WS_CLIENT_ENABLE_DYNAMIC_BUFFER=y
CONFIG_ESP_TASK_WDT_INIT=n

CONFIG_LV_USE_CLIB_MALLOC=y
CONFIG_LV_USE_CLIB_STRING=y
CONFIG_LV_USE_CLIB_SPRINTF=y
CONFIG_LV_USE_IMGFONT=y
CONFIG_LV_FONT_FMT_TXT_LARGE=y
CONFIG_LV_USE_FONT_COMPRESSED=y
CONFIG_LV_USE_ANIMIMG=n
CONFIG_LV_USE_CALENDAR=n
CONFIG_LV_USE_CALENDAR_HEADER_ARROW=n
CONFIG_LV_USE_CALENDAR_HEADER_DROPDOWN=n
CONFIG_LV_USE_KEYBOARD=n
CONFIG_LV_USE_LED=n
CONFIG_LV_USE_LIST=n
CONFIG_LV_USE_MENU=n
CONFIG_LV_USE_MSGBOX=n
CONFIG_LV_USE_SPAN=n
CONFIG_LV_USE_SPINBOX=n
CONFIG_LV_USE_SPINNER=n
CONFIG_LV_USE_TABVIEW=n
CONFIG_LV_USE_TILEVIEW=n
CONFIG_LV_USE_WIN=n
CONFIG_LV_BUILD_EXAMPLES=n

CONFIG_MBEDTLS_PSK_MODES=y
CONFIG_MBEDTLS_KEY_EXCHANGE_PSK=y
CONFIG_MBEDTLS_KEY_EXCHANGE_ECDHE_PSK=y
CONFIG_MBEDTLS_KEY_EXCHANGE_RSA_PSK=y
```

## src/Kconfig.projbuild
```kconfig
menu  "ESP AI Engine"
  choice
    prompt "Log Severity"
    default ESP_AI_ENGINE_LOGGER_SEVERITY_NONE
    config ESP_AI_ENGINE_LOGGER_SEVERITY_VERBOSE
      bool "VERBOSE"
    config ESP_AI_ENGINE_LOGGER_SEVERITY_DEBUG
      bool "DEBUG"
    config ESP_AI_ENGINE_LOGGER_SEVERITY_INFO
      bool "INFO"
    config ESP_AI_ENGINE_LOGGER_SEVERITY_WARN
      bool "WARN"
    config ESP_AI_ENGINE_LOGGER_SEVERITY_ERROR
      bool "ERROR"
    config ESP_AI_ENGINE_LOGGER_SEVERITY_FATAL
      bool "FATAL"
    config ESP_AI_ENGINE_LOGGER_SEVERITY_NONE
      bool "NONE"
  endchoice
endmenu
```
